## sdkconfig.defaults
```kconfig
CONFIG_FREERTOS_HZ=1000
CONFIG_AUTOSTART_ARDUINO=y

CONFIG_LWIP_MAX_SOCKETS=15
#CONFIG_PTHREAD_TASK_STACK_SIZE_DEFAULT=8192
CONFIG_PARTITION_TABLE_CUSTOM=y
CONFIG_PARTITION_TABLE_CUSTOM_FILENAME="ndefault.csv"
CONFIG_PARTITION_TABLE_FILENAME="ndefault.csv"
CONFIG_ESPTOOLPY_FLASHSIZE_4MB=y

CONFIG_SSL_USING_MBEDTLS=y
#CONFIG_LWIP_IPV6=y
CONFIG_MBEDTLS_THREADING_C=y
# CONFIG_MBEDTLS_THREADING_ALT is not set
CONFIG_MBEDTLS_THREADING_PTHREAD=y
CONFIG_PTHREAD_TASK_STACK_SIZE_DEFAULT=8192

CONFIG_ESP_TLS_PSK_VERIFICATION=y
```
